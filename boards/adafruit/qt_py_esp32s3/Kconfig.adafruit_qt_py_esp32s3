## boards/adafruit/qt_py_esp32s3/Kconfig.adafruit_qt_py_esp32s3
```kconfig
# Adafruit QT Py ESP32S3 board configuration

config BOARD_ADAFRUIT_QT_PY_ESP32S3
	# select SOC_ESP32S3_FN8
	select SOC_ESP32S3_MINI_N4R2
	select SOC_ESP32S3_PROCPU if BOARD_ADAFRUIT_QT_PY_ESP32S3_PROCPU
	select SOC_ESP32S3_APPCPU if BOARD_ADAFRUIT_QT_PY_ESP32S3_APPCPU
```

## boards/adafruit/qt_py_esp32s3/Kconfig.board
```kconfig
# Adafruit QT Py ESP32-S3 board configuration

config BOARD_ADAFRUIT_QTPY_ESP32S3
	bool "Adafruit QT Py ESP32-S3"
	depends on SOC_SERIES_ESP32S3

choice SOC_PART_NUMBER
	default SOC_ESP32S3_MINI_N4R2
#	default SOC_ESP32S3_FN8
endchoice
```

## boards/adafruit/qt_py_esp32s3/board.yml
```yaml
board:
  name: adafruit_qt_py_esp32s3
  vendor: adafruit
  socs:
  - name: esp32s3
```

## west.yml
```yaml
manifest:
  remotes:
    - name: zephyrproject-rtos
      url-base: https://github.com/zephyrproject-rtos
    - name: golioth
      url-base: https://github.com/golioth
    - name: eclipse-zenoh
      url-base: https://github.com/eclipse-zenoh

  projects:
    - name: zephyr
      remote: zephyrproject-rtos
      revision: main
      import:
        # By using name-allowlist we can clone only the modules that are
        # strictly needed by the application.
        name-allowlist:
          - cmsis
          - hal_espressif
          - mbedtls
          - mcuboot

    - name: golioth
      repo-path: golioth-firmware-sdk
      remote: golioth
      path: modules/lib/golioth-firmware-sdk
      revision: main
      submodules: true

    - name: zenoh
      repo-path: zenoh-pico
      remote: eclipse-zenoh
      revision: main
      path: modules/lib/zenoh
```
